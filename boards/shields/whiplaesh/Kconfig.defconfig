## boards/shields/whiplaesh/Kconfig.defconfig
```kconfig
if SHIELD_WHIPLAESH_LEFT

config ZMK_SPLIT_ROLE_CENTRAL
    default y

config ZMK_POINTING
    default y

config SPI
    default y

endif

if SHIELD_WHIPLAESH_LEFT || SHIELD_WHIPLAESH_RIGHT

config ZMK_KEYBOARD_NAME
    default "Whiplaesh"

config ZMK_SPLIT
    default y

endif
```

## boards/shields/whiplaesh/Kconfig.shield
```kconfig
config SHIELD_WHIPLAESH_LEFT
    def_bool $(shields_list_contains,whiplaesh_left)

config SHIELD_WHIPLAESH_RIGHT
    def_bool $(shields_list_contains,whiplaesh_right)
```

## config/west.yml
```yaml
manifest:
  remotes:
    - name: zmkfirmware
      url-base: https://github.com/zmkfirmware
    - name: petejohanson
      url-base: https://github.com/petejohanson
    - name: urob
      url-base: https://github.com/urob
    - name: badjeff
      url-base: https://github.com/badjeff
    - name: sadekbaroudi
      url-base: https://github.com/sadekbaroudi
    - name: ykz89
      url-base: https://github.com/ykz89
    # Additional modules containing boards/shields/custom code can be listed here as well
    # See https://docs.zephyrproject.org/3.2.0/develop/west/manifest.html#projects
  projects:
    - name: zmk
      remote: zmkfirmware
      revision: main
      import: app/west.yml
    - name: zmk-pmw3610-driver
      remote: ykz89
      revision: main
    - name: zmk-helpers
      remote: urob
      revision: main
  self:
    path: config
```
