#include "whiplaesh.dtsi"
#include "whiplaesh_3610.dtsi"

&kscan0 {
    compatible = "zmk,kscan-gpio-matrix";

    col-gpios
        = <&pro_micro 19 GPIO_ACTIVE_HIGH>
        , <&pro_micro 18 GPIO_ACTIVE_HIGH>
        , <&pro_micro 15 GPIO_ACTIVE_HIGH>
        , <&pro_micro 14 GPIO_ACTIVE_HIGH>
        , <&pro_micro 16 GPIO_ACTIVE_HIGH>
        ;
};

&spi0 {
    status = "okay";
};

/ {
  trackball_listener {
    compatible = "zmk,input-listener";
    status = "okay";
    device = <&trackball>;
  };
};